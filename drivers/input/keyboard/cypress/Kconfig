## drivers/input/keyboard/cypress/Kconfig
```kconfig
#
# Cypress touchkey configuration
#

config KEYBOARD_CYPRESS_TOUCH
	tristate "Cypress touchkey support"
	help
	  Say Y here to enable the cypress touchkey.

	  To compile this driver as a module, choose M here.

config CM_BLN
       bool "Standard CyanogenMod LED Notification functionality"
       default y
       help
         Say Y here to enable the backlight notification
         for android led-notification (modified liblight needed)
```
